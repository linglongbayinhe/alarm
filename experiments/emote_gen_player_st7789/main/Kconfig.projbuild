## experiments/emote_gen_player_st7789/main/Kconfig.projbuild
```kconfig
menu "Emote Gen Player ST7789 Experiment"

    choice EMOTE_EXPERIMENT_ASSET_SOURCE
        prompt "Emote Gen asset source"
        default EMOTE_EXPERIMENT_ASSET_SOURCE_PARTITION

        config EMOTE_EXPERIMENT_ASSET_SOURCE_PATH
            bool "Filesystem path"

        config EMOTE_EXPERIMENT_ASSET_SOURCE_PARTITION
            bool "Partition label"
    endchoice

    config EMOTE_EXPERIMENT_ASSET_PATH
        string "Asset pack filesystem path"
        depends on EMOTE_EXPERIMENT_ASSET_SOURCE_PATH
        default "/ext/emote/normal.bin"

    config EMOTE_EXPERIMENT_MOUNT_EXTERNAL_FATFS
        bool "Mount external W25Q128 FATFS at /ext"
        depends on EMOTE_EXPERIMENT_ASSET_SOURCE_PATH
        default y

    config EMOTE_EXPERIMENT_ASSET_PARTITION_LABEL
        string "Asset partition label"
        depends on EMOTE_EXPERIMENT_ASSET_SOURCE_PARTITION
        default "emote_gen"

    config EMOTE_EXPERIMENT_MMAP_ENABLE
        bool "Enable mmap asset access"
        default y

    config EMOTE_EXPERIMENT_INITIAL_ANIM_NAME
        string "Initial animation name"
        default "normal"

    config EMOTE_EXPERIMENT_FALLBACK_ANIM_NAME
        string "Fallback animation name"
        default "idle"

    config EMOTE_EXPERIMENT_FPS
        int "Render FPS"
        range 5 60
        default 30

    config EMOTE_EXPERIMENT_BUFFER_LINES
        int "Flush buffer lines"
        range 1 240
        default 8

    config EMOTE_EXPERIMENT_TASK_PRIORITY
        int "Player task priority"
        range 1 24
        default 5

    config EMOTE_EXPERIMENT_TASK_STACK
        int "Player task stack bytes"
        range 4096 32768
        default 8192

    config EMOTE_EXPERIMENT_BUFF_SPIRAM
        bool "Prefer PSRAM for player buffers"
        default n
        help
            Keep this disabled for the first validation because SPI LCD
            transfers need DMA-capable memory. Enable later only after the
            basic flush path is proven stable.

    config EMOTE_EXPERIMENT_COLOR_SWAP
        bool "Swap RGB565 bytes in player output"
        default n

endmenu
```

## experiments/emote_gen_player_st7789/sdkconfig.defaults
```kconfig
CONFIG_PARTITION_TABLE_CUSTOM=y
CONFIG_PARTITION_TABLE_CUSTOM_FILENAME="partitions.csv"

CONFIG_ESPTOOLPY_FLASHSIZE_8MB=y
CONFIG_ESPTOOLPY_FLASHSIZE="8MB"

CONFIG_SPIRAM=y
CONFIG_SPIRAM_USE_MALLOC=y

CONFIG_FREERTOS_HZ=100

CONFIG_EMOTE_EXPERIMENT_ASSET_SOURCE_PARTITION=y
CONFIG_EMOTE_EXPERIMENT_ASSET_PARTITION_LABEL="emote_gen"
CONFIG_EMOTE_EXPERIMENT_MMAP_ENABLE=y
CONFIG_EMOTE_EXPERIMENT_INITIAL_ANIM_NAME="normal"
```

## main/Kconfig.projbuild
```kconfig
menu "Example Configuration"

    config EXAMPLE_WIFI_CONNECTION_MAXIMUM_RETRY
        int "WiFi connection maximum retry"
        range 0 255
        default 2
        help
            WiFi connection maximum retry, from 0 to 255.

    choice EXAMPLE_WIFI_SCAN_AUTH_MODE_THRESHOLD
        prompt "WiFi Scan auth mode threshold"
        default ESP_WIFI_AUTH_WPA2_PSK
        help
            The weakest authmode to accept in the scan mode.
            This value defaults to ESP_WIFI_AUTH_WPA2_PSK in case password is present and ESP_WIFI_AUTH_OPEN is used.
            Please select ESP_WIFI_AUTH_WEP/ESP_WIFI_AUTH_WPA_PSK in case AP is operating in WEP/WPA mode.

        config ESP_WIFI_AUTH_OPEN
            bool "OPEN"
        config ESP_WIFI_AUTH_WEP
            bool "WEP"
        config ESP_WIFI_AUTH_WPA_PSK
            bool "WPA PSK"
        config ESP_WIFI_AUTH_WPA2_PSK
            bool "WPA2 PSK"
        config ESP_WIFI_AUTH_WPA_WPA2_PSK
            bool "WPA/WPA2 PSK"
        config ESP_WIFI_AUTH_WPA3_PSK
            bool "WPA3 PSK"
        config ESP_WIFI_AUTH_WPA2_WPA3_PSK
            bool "WPA2/WPA3 PSK"
        config ESP_WIFI_AUTH_WAPI_PSK
            bool "WAPI PSK"
    endchoice

    config EXAMPLE_BLUFI_BLE_SMP_ENABLE
        bool "Enable BLE SMP support in BLUFI"
        depends on BT_BLUEDROID_ENABLED
        select BT_BLUFI_BLE_SMP_ENABLE
        select BT_BLE_SMP_ENABLE
        default n
        help
            Enable BLE Security Manager Protocol (SMP) for BLUFI.
            Currently, this feature is only supported with the Bluedroid host.

            If enabled:
            - BLUFI will configure SMP security parameters such as
            IO capabilities, authentication mode, and key size.
            - After a BLE connection is established, BLUFI will
            proactively initiate a security request.
            - Only after the BLE pairing is successfully completed,
            BLUFI can proceed with Wi-Fi provisioning.
            - If the user rejects pairing or inputs an incorrect passkey,
            BLUFI will not start Wi-Fi provisioning.

    menu "Application production controls"

        config APP_EXTERNAL_AUDIO_CACHE_ENABLE
            bool "Enable external audio cache (W25Q128)"
            default n
            help
                Enable initialization of the external SPI flash audio cache.
                Keep this disabled while validating internal SPIFFS fallback
                audio and local alarm playback without W25Q128 involvement.

        config APP_LOG_SENSITIVE_DATA
            bool "Log sensitive provisioning payloads"
            default n
            help
                Development-only switch. Keep disabled for production so Wi-Fi
                passwords and custom provisioning payloads are never printed.

    endmenu
endmenu
```

## sdkconfig.defaults
```kconfig
# Override some defaults so BT stack is enabled
# in this example

#
# Partition Table
# (It's possible to fit Blufi in 1MB app partition size with some other optimizations, but
# default config is close to 1MB.)
CONFIG_PARTITION_TABLE_CUSTOM=y
CONFIG_PARTITION_TABLE_CUSTOM_FILENAME="partitions.csv"
CONFIG_COMPILER_OPTIMIZATION_SIZE=y
CONFIG_ESPTOOLPY_FLASHSIZE_8MB=y
CONFIG_ESPTOOLPY_FLASHSIZE="8MB"

#
# BT config
#
CONFIG_BT_ENABLED=y
CONFIG_BT_GATTC_ENABLE=n
CONFIG_BT_BLE_SMP_ENABLE=n
CONFIG_BT_BLE_BLUFI_ENABLE=y
CONFIG_MBEDTLS_HARDWARE_MPI=y
CONFIG_ESP_TLS_INSECURE=y
CONFIG_ESP_TLS_SKIP_SERVER_CERT_VERIFY=y
CONFIG_MBEDTLS_ASYMMETRIC_CONTENT_LEN=y
CONFIG_MBEDTLS_SSL_IN_CONTENT_LEN=16384
CONFIG_MBEDTLS_SSL_OUT_CONTENT_LEN=2048
# CONFIG_MBEDTLS_DYNAMIC_BUFFER is not set
# CONFIG_MBEDTLS_SSL_MAX_FRAGMENT_LENGTH is not set
# CONFIG_MBEDTLS_SSL_VARIABLE_BUFFER_LENGTH is not set
CONFIG_ESP32_WIFI_RX_BA_WIN=4
CONFIG_ESP_WIFI_STATIC_RX_BUFFER_NUM=6
CONFIG_ESP_WIFI_DYNAMIC_RX_BUFFER_NUM=16
CONFIG_ESP_WIFI_DYNAMIC_TX_BUFFER_NUM=16
CONFIG_ESP_MAIN_TASK_STACK_SIZE=8192
# CONFIG_ESP_WIFI_ENABLE_WPA3_SAE is not set
# CONFIG_ESP_WIFI_ENABLE_WPA3_OWE_STA is not set
# CONFIG_LWIP_IPV6 is not set
CONFIG_LWIP_MAX_ACTIVE_TCP=6
CONFIG_LWIP_MAX_LISTENING_TCP=4
CONFIG_LWIP_MAX_UDP_PCBS=6
CONFIG_LWIP_MAX_RAW_PCBS=4
CONFIG_LWIP_DNS_MAX_SERVERS=2
# CONFIG_MBEDTLS_CERTIFICATE_BUNDLE is not set
CONFIG_MBEDTLS_CERTIFICATE_BUNDLE_DEFAULT_NONE=y
# CONFIG_MBEDTLS_TLS_SERVER is not set
CONFIG_MBEDTLS_TLS_CLIENT=y
CONFIG_MBEDTLS_TLS_CLIENT_ONLY=y
# CONFIG_MBEDTLS_ERROR_STRINGS is not set
# CONFIG_MBEDTLS_SELF_TEST is not set
# CONFIG_MBEDTLS_PEM_WRITE_C is not set
CONFIG_MBEDTLS_PK_WRITE_C=y
# CONFIG_MBEDTLS_X509_CRL_PARSE_C is not set
# CONFIG_MBEDTLS_X509_CSR_PARSE_C is not set
# CONFIG_MBEDTLS_SSL_RENEGOTIATION is not set
# CONFIG_MBEDTLS_CLIENT_SSL_SESSION_TICKETS is not set
# CONFIG_MBEDTLS_SERVER_SSL_SESSION_TICKETS is not set
CONFIG_LV_MEM_SIZE_KILOBYTES=24
CONFIG_LV_USE_QRCODE=y
# CONFIG_AUDIO_DECODER_AAC_SUPPORT is not set
CONFIG_AUDIO_DECODER_MP3_SUPPORT=y
# CONFIG_AUDIO_DECODER_G711_SUPPORT is not set
# CONFIG_AUDIO_DECODER_AMRNB_SUPPORT is not set
# CONFIG_AUDIO_DECODER_AMRWB_SUPPORT is not set
# CONFIG_AUDIO_DECODER_FLAC_SUPPORT is not set
# CONFIG_AUDIO_DECODER_OPUS_SUPPORT is not set
# CONFIG_AUDIO_DECODER_VORBIS_SUPPORT is not set
# CONFIG_AUDIO_DECODER_ADPCM_SUPPORT is not set
# CONFIG_AUDIO_DECODER_ALAC_SUPPORT is not set
# CONFIG_AUDIO_DECODER_PCM_SUPPORT is not set
# CONFIG_AUDIO_DECODER_SBC_SUPPORT is not set
# CONFIG_AUDIO_DECODER_LC3_SUPPORT is not set
# CONFIG_AUDIO_SIMPLE_DEC_WAV_SUPPORT is not set
# CONFIG_AUDIO_SIMPLE_DEC_M4A_SUPPORT is not set
# CONFIG_AUDIO_SIMPLE_DEC_TS_SUPPORT is not set

#
# Application config
#
CONFIG_APP_EXTERNAL_AUDIO_CACHE_ENABLE=y
```
